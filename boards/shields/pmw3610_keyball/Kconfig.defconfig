## boards/shields/pmw3610_keyball/Kconfig.defconfig
```kconfig
if SHIELD_PMW3610_KEYBALL_LEFT

config ZMK_KEYBOARD_NAME
    default "pmw3610_keyball"

config ZMK_SPLIT_ROLE_CENTRAL
    default y

endif # SHIELD_PMW3610_KEYBALL_LEFT

if SHIELD_PMW3610_KEYBALL_LEFT || SHIELD_PMW3610_KEYBALL_RIGHT

config ZMK_SPLIT
    default y

endif # SHIELD_PMW3610_KEYBALL_LEFT || SHIELD_PMW3610_KEYBALL_RIGHT
```

## boards/shields/pmw3610_keyball/Kconfig.shield
```kconfig
config SHIELD_PMW3610_KEYBALL_LEFT
    def_bool $(shields_list_contains,pmw3610_keyball_left)

config SHIELD_PMW3610_KEYBALL_RIGHT
    def_bool $(shields_list_contains,pmw3610_keyball_right)
```

## config/drivers/kscan/Kconfig
```kconfig
# config/drivers/kscan/Kconfig

config KSCAN_JAPANESE_DUPLEX
    bool "Japanese Duplex Matrix KSCAN driver"
    default y
    depends on DT_HAS_ZMK_KSCAN_JAPANESE_DUPLEX_ENABLED
    select TICKLESS_KERNEL
    help
      Enable the Japanese Duplex Matrix KSCAN driver for 
      bidirectional matrix scanning.
```
